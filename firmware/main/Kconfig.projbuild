## firmware/main/Kconfig.projbuild
```kconfig
# xiaozhi's options (language, wake word, OTA URL, ...) stay defined upstream
# and are pulled in as-is; NB3 options get their own menu here when needed.
rsource "../xiaozhi-esp32/main/Kconfig.projbuild"

menu "NoiseBot v3"

config NB3_AEC_DELAY_SAMPLES
    int "AEC software reference delay in 24 kHz samples"
    range 0 480
    default 120
    depends on USE_DEVICE_AEC
    help
        120 is an uncalibrated starting value. Compare 120 and 0 with the
        same playback and measure mic/reference alignment before changing it.

config NB3_AUDIO_DIAGNOSTICS
    bool "Log microphone/reference diagnostics every five seconds"
    default n
    help
        Log peaks, clipped mic samples, capture errors and reference alignment
        counters. No PCM is stored. For deliberate synchronized mic/ref capture,
        use USE_AUDIO_DEBUGGER with AUDIO_DEBUG_UDP_SERVER configured explicitly.

config NB3_MICRO_WAKE_WORD
    bool "Wake on \"Nexo\" (microWakeWord on TFLite Micro)"
    default y
    help
        Detect the wake word with the microWakeWord model in main/wake
        instead of esp-sr's WakeNet. Off falls back to the WakeNet model
        selected in the esp-sr options.

config NB3_WAKE_PREVIOUS_MODEL
    bool "Use the previously hardware-tested Nexo model"
    depends on NB3_MICRO_WAKE_WORD
    default y
    help
        Use the Nexo model previously tested with the owner's voice. Disable
        to compare the newer model without replacing either model file.

config NB3_BARGE_IN_GATE
    bool "Interrupt the robot only with speech, not noise"
    default y
    depends on USE_DEVICE_AEC
    help
        While the robot speaks in realtime mode, hold the mic stream back
        until the local voice detector has heard sustained speech, so the
        server does not cut the reply on a knock or a fan.

config NB3_GAP_BRIDGE_MS
    int "Hide pauses of up to this many ms from the server (0 = off)"
    default 700
    range 0 3000
    help
        The server ends a turn as soon as the mic stream is quiet for its own
        short time, so a breath between two phrases cuts the question. While
        listening, once the person has spoken, frames the voice detector calls
        silence are held back for up to this long. If speech returns the server
        hears one continuous utterance; if the silence lasts longer it is sent
        live and the server ends the turn, so every answer is this much later.
        Not used with the barge-in gate (device AEC).

endmenu
```
